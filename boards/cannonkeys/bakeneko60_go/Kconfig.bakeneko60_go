## boards/cannonkeys/bakeneko60_go/Kconfig.bakeneko60_go
```kconfig
# Copyright (c) 2023 Andrew Kannan
# SPDX-License-Identifier: MIT

config BOARD_BAKENEKO60_GO
    select SOC_NRF52840_QIAA
    select ZMK_BOARD_COMPAT

config BOARD_ENABLE_DCDC
    bool "Enable DCDC mode"
    select SOC_DCDC_NRF52X
    default y
    depends on BOARD_BAKENEKO60_GO
```

## boards/cannonkeys/bakeneko60_go/Kconfig.defconfig
```kconfig
# Copyright (c) 2023 Andrew Kannan
# SPDX-License-Identifier: MIT

if BOARD_BAKENEKO60_GO

config ZMK_KEYBOARD_NAME
    default "Bakeneko60 Go"

config ZMK_BLE
    default y

config ZMK_USB
    default y

endif # BOARD_BAKENEKO60_GO
```

## boards/cannonkeys/bakeneko60_go/bakeneko60_go_nrf52840_zmk_defconfig
```kconfig
# Copyright (c) 2023 Andrew Kannan
# SPDX-License-Identifier: MIT

# Enable MPU
CONFIG_ARM_MPU=y

CONFIG_PINCTRL=y

# enable GPIO
CONFIG_GPIO=y

CONFIG_USE_DT_CODE_PARTITION=y
CONFIG_BUILD_OUTPUT_UF2=y

CONFIG_RETAINED_MEM=n
CONFIG_RETENTION=n
CONFIG_RETENTION_BOOT_MODE=n
CONFIG_NRF_STORE_REBOOT_TYPE_GPREGRET=n

CONFIG_MPU_ALLOW_FLASH_WRITE=y
CONFIG_NVS=y
CONFIG_SETTINGS_NVS=y
CONFIG_FLASH=y
CONFIG_FLASH_PAGE_LAYOUT=y
CONFIG_FLASH_MAP=y

CONFIG_ZMK_RGB_UNDERGLOW=y
CONFIG_LED_STRIP=y

CONFIG_ZMK_RGB_UNDERGLOW_HUE_START=160
CONFIG_ZMK_RGB_UNDERGLOW_EFF_START=3
CONFIG_ZMK_RGB_UNDERGLOW_BRT_MIN=10
CONFIG_ZMK_RGB_UNDERGLOW_BRT_MAX=50

CONFIG_ZMK_SLEEP=y
CONFIG_ZMK_RGB_UNDERGLOW_AUTO_OFF_IDLE=n
CONFIG_ZMK_IDLE_TIMEOUT=60000
CONFIG_ZMK_IDLE_SLEEP_TIMEOUT=3600000
```
